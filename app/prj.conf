## CMakeLists.txt
```
cmake_minimum_required(VERSION 3.20.0)

find_package(Zephyr REQUIRED HINTS $ENV{ZEPHYR_BASE})
project(tflite_micro_example)

set(NO_THREADSAFE_STATICS $<TARGET_PROPERTY:compiler-cpp,no_threadsafe_statics>)
zephyr_compile_options($<$<COMPILE_LANGUAGE:CXX>:${NO_THREADSAFE_STATICS}>)
set(CMAKE_CXX_FLAGS "${CMAKE_CXX_FLAGS} -fpermissive")

if("$ENV{DEBUG}" STREQUAL "1")
    add_compile_definitions(DEBUG=1)
endif()

file(GLOB APP_SOURCES_C src/*.c)
file(GLOB APP_SOURCES_CPP src/*.cpp)
file(GLOB TASK_SOURCES_CPP src/*/*.cpp)
set(APP_SOURCES "${APP_SOURCES_C};${APP_SOURCES_CPP};${TASK_SOURCES_CPP}")
message("-- APP_SOURCES=${APP_SOURCES}")

target_include_directories(app PRIVATE src)
target_sources(app PRIVATE "${APP_SOURCES}")
target_link_libraries(app PRIVATE zephyr zephyr_interface)


################################################################################
# HTTP SERVER
target_link_libraries(app PRIVATE zephyr_interface zephyr)
zephyr_linker_sources(SECTIONS sections-rom.ld)
zephyr_linker_section(NAME http_resource_desc_httpserver_service
    KVMA RAM_REGION GROUP RODATA_REGION SUBALIGN Z_LINK_ITERABLE_SUBALIGN)
```

## prj.conf
```kconfig
CONFIG_CPP_EXCEPTIONS=y
CONFIG_GLIBCXX_LIBCPP=y
#
# LOGGING
CONFIG_NET_LOG=y

CONFIG_TEST_RANDOM_GENERATOR=y

CONFIG_WIFI=y
CONFIG_INIT_STACKS=y
CONFIG_NET_L2_WIFI_MGMT=y
CONFIG_NET_L2_ETHERNET=y
CONFIG_NETWORKING=y
CONFIG_NET_IPV4=y
CONFIG_NET_IPV6=n
CONFIG_NET_TCP=y
CONFIG_NET_ARP=y
CONFIG_NET_NATIVE=y
CONFIG_NET_CONFIG_SETTINGS=y
CONFIG_NET_CONFIG_INIT_TIMEOUT=1
CONFIG_NET_CONTEXT_NET_PKT_POOL=y

CONFIG_NET_CONFIG_NEED_IPV4=y

# TPLINK CONFIG
CONFIG_NET_DHCPV4=y

# HOME CONFIG
# CONFIG_NET_DHCPV4=n
# CONFIG_NET_CONFIG_MY_IPV4_ADDR="192.168.178.111"
# CONFIG_NET_CONFIG_MY_IPV4_GW="192.168.178.1"

# EXTERNAL ROUTER CONFIG
# CONFIG_NET_DHCPV4=n
# CONFIG_NET_CONFIG_MY_IPV4_ADDR="192.168.100.111"
# CONFIG_NET_CONFIG_MY_IPV4_GW="192.168.100.1"

CONFIG_NET_TX_STACK_SIZE=2048
CONFIG_NET_RX_STACK_SIZE=2048
CONFIG_NET_PKT_RX_COUNT=16
CONFIG_NET_PKT_TX_COUNT=16
CONFIG_NET_BUF_RX_COUNT=16
CONFIG_NET_BUF_TX_COUNT=16
CONFIG_NET_MAX_CONTEXTS=10

CONFIG_NET_SOCKETS=y
CONFIG_HTTP_CLIENT=y
CONFIG_NET_SOCKETS_LOG_LEVEL_DBG=y
CONFIG_NET_HTTP_LOG_LEVEL_DBG=y
CONFIG_NET_HTTP_SERVER_LOG_LEVEL_DBG=y
CONFIG_HTTP_SERVER=y
CONFIG_HTTP_SERVER_MAX_CLIENTS=2
CONFIG_EVENTFD=y

CONFIG_POSIX_API=y
CONFIG_POSIX_TIMERS=y
CONFIG_FDTABLE=y

CONFIG_CPP=y
CONFIG_NEWLIB_LIBC=y
CONFIG_MAIN_STACK_SIZE=2048

# logging
CONFIG_LOG=y
CONFIG_LOG_PRINTK=y
CONFIG_LOG_MODE_IMMEDIATE=y

# UART
CONFIG_UART_INTERRUPT_DRIVEN=n
CONFIG_SERIAL=y
CONFIG_UART_CONSOLE=y

CONFIG_PRINTK_BUFFER_SIZE=2048
```

## src/main.c
```c
#include "main.h"

int main()
{
    return run_main();
}
```

## src/main.cpp
```c
#include <errno.h>
#include <exception>
#include <stdlib.h>

#include <zephyr/device.h>
#include <zephyr/devicetree.h>
#include <zephyr/drivers/flash.h>
#include <zephyr/kernel.h>
#include <zephyr/logging/log.h>
#include <zephyr/net/socket.h>

#include "config.h"
#include "httpserver.h"
#include "main.h"
#include "wifi.h"

////////////////////////////////////////////////////////////////////////////////
/// MAIN
int run_main()
{
    try
    {
        // wifi_init();
        // wifi_connect(SSID, PSK);
        // http_server_start();

        sockaddr_in addr4;
        addr4.sin_family = AF_INET;
        addr4.sin_port = htons(80);
        zsock_inet_pton(AF_INET, "0.0.0.0", &addr4.sin_addr);
        size_t len = sizeof(sockaddr_in);

        int sock = zsock_socket(AF_INET, SOCK_STREAM, IPPROTO_TCP);
        if (sock < 0)
        {
            printk("Socket creation failed\n");
            return 1;
        }

        int flag = 1;
        if (zsock_setsockopt(sock, SOL_SOCKET, SO_REUSEADDR, &flag, sizeof(int)) < 0)
        {
            printk("setsockopt: %d\n", errno);
            zsock_close(sock);
            return 1;
        }

        if (zsock_bind(sock, (sockaddr *)&addr4, sizeof(addr4)) < 0)
        {
            printk("bind: %d\n", errno);
            zsock_close(sock);
            return 1;
        }

        if (listen(sock, 1) < 0)
        {
            printk("listen: %d\n", errno);
            zsock_close(sock);
            return 1;
        }
    }
    catch (std::exception &e)
    {
        printk("Exception: %s\n", e.what());
        return 1;
    }

    printk("Main thread done, sleeping forever...");
    k_sleep(K_FOREVER);
    return 0;
}
```

## src/config.h
```c
#pragma once

////////////////////////////////////////////////////////////////////////////////
/// TPLINK CONFIG
#define SSID "SSID"
#define PSK "PASSWORD"
#define BACKEND_IP "10.128.162.229"
#define BACKEND_PORT 8081

////////////////////////////////////////////////////////////////////////////////
/// HTTP SERVER
#define HTTP_SERVER_PORT 80
```

## src/httpserver.cpp
```c
#include "httpserver.h"

int handle_data_start(http_client_ctx *client, http_data_status status, uint8_t *buffer, size_t len, void *user_data)
{
    printk("Start data acquisition task\n");
    return 0;
}
```

## src/httpserver.h
```c
#pragma once

#include <zephyr/net/http/server.h>
#include <zephyr/net/http/service.h>

#include "config.h"

static uint8_t recv_buffer[1024];

static uint16_t http_server_port = HTTP_SERVER_PORT;
HTTP_SERVICE_DEFINE(httpserver_service, "0.0.0.0", &http_server_port, 2, 10, nullptr);

////////////////////////////////////////////////////////////////////////////////
/// DATA
int handle_data_start(http_client_ctx *client, http_data_status status, uint8_t *buffer, size_t len, void *user_data);

static http_resource_detail_dynamic data_start_resource_detail = {
    .common = {.bitmask_of_supported_http_methods = BIT(HTTP_GET), .type = HTTP_RESOURCE_TYPE_DYNAMIC},
    .cb = handle_data_start,
    .data_buffer = recv_buffer,
    .data_buffer_len = sizeof(recv_buffer),
    .user_data = nullptr};

HTTP_RESOURCE_DEFINE(data_start_resource, httpserver_service, "/data/start", &data_start_resource_detail);
```

## src/main.h
```c
#pragma once

#ifdef __cplusplus
extern "C"
{
#endif

    int run_main();

#ifdef __cplusplus
}
#endif
```

## src/wifi.cpp
```c
#include <zephyr/net/net_event.h>
#include <zephyr/net/net_if.h>
#include <zephyr/net/wifi_mgmt.h>

#include "wifi.h"

static struct net_mgmt_event_callback wifi_cb;

static K_SEM_DEFINE(wifi_connected, 0, 1);
static K_SEM_DEFINE(ipv4_address_obtained, 0, 1);

////////////////////////////////////////////////////////////////////////////////
/// IMPL
static void handle_wifi_connect_result(net_mgmt_event_callback *cb)
{
    const wifi_status *status = (const wifi_status *)cb->info;
    if (status->status)
    {
        printk("Connection request failed status (%i)\n", status->status);
    }
    else
    {
        printk("Connected\n");
        k_sem_give(&wifi_connected);
    }
}

static void handle_wifi_disconnect_result(net_mgmt_event_callback *cb)
{
    const wifi_status *status = (const wifi_status *)cb->info;

    if (status->status)
    {
        printk("Disconnection request (%d)\n", status->status);
    }
    else
    {
        printk("Disconnected\n");
        k_sem_take(&wifi_connected, K_NO_WAIT);
    }
}

static void handle_ipv4_result(struct net_if *iface)
{
    k_sem_give(&ipv4_address_obtained);
    printk("IP Address obtained...\n");
}

static void wifi_mgmt_event_handler(net_mgmt_event_callback *cb, uint32_t mgmt_event, struct net_if *iface)
{
    switch (mgmt_event)
    {

    case NET_EVENT_WIFI_CONNECT_RESULT:
        handle_wifi_connect_result(cb);
        break;

    case NET_EVENT_WIFI_DISCONNECT_RESULT:
        handle_wifi_disconnect_result(cb);
        break;

    case NET_EVENT_IPV4_ADDR_ADD:
        handle_ipv4_result(iface);
        break;

    default:
        break;
    }
}

////////////////////////////////////////////////////////////////////////////////
/// API
int wifi_connect(const char *ssid, const char *psk)
{
    struct net_if *iface = net_if_get_default();

    struct wifi_connect_req_params wifi_params = {0};
    wifi_params.ssid = (uint8_t *)ssid;
    wifi_params.psk = (uint8_t *)psk;
    wifi_params.ssid_length = strlen(ssid);
    wifi_params.psk_length = strlen(psk);
    wifi_params.channel = 0;
    wifi_params.security = WIFI_SECURITY_TYPE_PSK;
    wifi_params.band = WIFI_FREQ_BAND_2_4_GHZ;
    wifi_params.mfp = WIFI_MFP_OPTIONAL;
    wifi_params.timeout = 20;

    printk("Connecting to SSID: %s\n", wifi_params.ssid);
    if (net_mgmt(NET_REQUEST_WIFI_CONNECT, iface, &wifi_params, sizeof(struct wifi_connect_req_params)))
    {
        printk("WiFi Connection Request Failed\n");
        return 1;
    }

    k_sem_take(&wifi_connected, K_FOREVER);

    // printk("Waiting for IP Address...\n");
    // k_sem_take(&ipv4_address_obtained, K_FOREVER);

    return 0;
}

int wifi_disconnect()
{
    struct net_if *iface = net_if_get_default();

    if (net_mgmt(NET_REQUEST_WIFI_DISCONNECT, iface, NULL, 0))
    {
        printk("WiFi Disconnection Request Failed\n");
        return 1;
    }

    return 0;
}

void wifi_init()
{
    printk("WiFi initializing...\n");
    net_mgmt_init_event_callback(&wifi_cb, wifi_mgmt_event_handler,
                                 NET_EVENT_WIFI_CONNECT_RESULT | NET_EVENT_WIFI_DISCONNECT_RESULT);
    net_mgmt_add_event_callback(&wifi_cb);
    printk("WiFi initialized...\n");
}
```

## src/wifi.h
```c
#pragma once

void wifi_init();
int wifi_connect(const char *ssid, const char *psk);
int wifi_disconnect();
```
